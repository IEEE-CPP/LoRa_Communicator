## lib/zephyr-workspace/west-manifest/west.yml
```yaml
manifest:
  remotes:
    - name: zephyrproject
      url-base: https://github.com/zephyrproject-rtos
  projects:
    - name: zephyr
      repo-path: zephyr
      remote: zephyrproject
      path: zephyr
      revision: v4.4.0
      clone-depth: 1
      import:
        name-allowlist:
          - cmsis_6
          - hal_espressif
          - picolibc
          - segger
```
